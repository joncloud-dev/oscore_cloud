## Kconfig
```kconfig
# SPDX-License-Identifier: Apache-2.0
#
# oscore_cloud: reusable OSCORE cloud client library.

menuconfig OSCORE_CLOUD
	bool "OSCORE cloud client library"
	depends on UOSCORE
	help
	  A framework-agnostic OSCORE cloud client: CoAP/OSCORE transport, a
	  minimal CBOR codec, and structured telemetry / device-shadow / downlink
	  operations. It has no dependency on zbus or the Zephyr State Machine
	  Framework and can be driven from a plain main()-loop application.

	  Enabling this requires a CoAP + UDP socket transport (CONFIG_COAP,
	  CONFIG_NET_SOCKETS) and, for replay-counter persistence, the settings
	  subsystem (CONFIG_SETTINGS).

if OSCORE_CLOUD

config OSCORE_SERVER_IP
	string "OSCORE server IPv4 address"
	default "192.168.1.100"
	help
	  Default CoAP/OSCORE server address (IPv4, as a string). Used as the
	  compile-time default by the client when the application does not set
	  struct oscore_cloud_config.server_ip at runtime.

config OSCORE_USE_EDHOC
	bool "Use EDHOC for OSCORE key establishment"
	default n
	help
	  Run EDHOC (POST /.well-known/edhoc) with the server to derive the OSCORE
	  context at runtime instead of using a provisioned / hardcoded context.
	  When enabled, the application must provide edhoc_credentials.h. Leave
	  disabled to use the bench-provisioned opaque-key context (the default).

config OSCORE_CLOUD_BLOCK2_SZX
	int "Block2 download block size exponent (SZX)"
	range 0 6
	default 6
	help
	  CoAP block size exponent for the OSCORE Block2 downloads (FOTA image,
	  A-GNSS, P-GPS): block size = 16 << SZX bytes. 6 (1024 B, the CoAP-over-UDP
	  maximum) halves the round-trips compared with 5 (512 B).

	  1024 B needs a server with go-coap's automatic outer block-wise transfer
	  disabled. Older servers re-fragment any OSCORE ciphertext of 1024 B or more
	  with an outer Block2 option that this client does not reassemble, and every
	  block then fails to decrypt (uoscore error -3). Set 5 for those servers.

config OSCORE_CLOUD_RAI
	bool "Release Assistance Indication (SO_RAI) hints"
	depends on NRF_MODEM_LIB
	default y
	help
	  Let the application tell the modem when no more data is expected
	  (cloud_client_rai_next() / cloud_client_rai_release()), so the network
	  can release the RRC connection right after an uplink instead of waiting
	  for its inactivity timer. Block1/Block2 transfers keep the link up
	  (RAI_ONGOING) on every block. Needs CONFIG_LTE_RAI_REQ for the modem to
	  request RAI from the network. When disabled the API is a no-op.

	  Default on: on an nRF9151 DK (Telenor NO, 2026-11-10) it cut the RRC
	  connected time per telemetry post from 5.8 s to about 2.8 s on LTE-M and
	  from about 10.5 s to 0.3 s on NB-IoT. Where the network offers no RAI
	  the hints have no effect.

config OSCORE_CLOUD_SESSION
	bool "Connection / session helper"
	default y
	help
	  Build the framework-free connection helper (oscore_cloud_connect,
	  reconnection backoff, and oscore_cloud_send_telemetry which posts a
	  telemetry record and drives the resulting downlink / FOTA work). A
	  simple application uses this instead of writing its own state machine.

config OSCORE_CLOUD_FOTA
	bool "OSCORE FOTA client"
	depends on DFU_TARGET
	help
	  Build the OSCORE FOTA client (GET/POST /f, Block2 image download,
	  MCUboot / modem-delta apply and boot-time reconciliation).

config OSCORE_CLOUD_AGNSS
	bool "OSCORE A-GNSS client"
	help
	  Build the OSCORE A-GNSS client that fetches GPS assistance (POST /a,
	  CBOR over Block2) and writes it to the nRF modem GNSS core.

if OSCORE_CLOUD_AGNSS

config OSCORE_CLOUD_AGNSS_WINDOW_S_DEFAULT
	int "Default A-GNSS pruning look-ahead window (seconds)"
	default 7200
	help
	  Look-ahead window (request field "w") sent by agnss_client_fetch() when
	  the caller does not override it via agnss_client_fetch_ex(). The server
	  keeps only satellites visible within this window. 7200 = 2 hours; use 0
	  for a single-shot / instant fetch (only satellites visible now).

config OSCORE_CLOUD_AGNSS_MAX_SV_DEFAULT
	int "Default A-GNSS satellite cap (0 = uncapped)"
	default 0
	help
	  Cap on the number of satellites the server returns (request field "n"),
	  azimuth-spread selected. 0 leaves the visible set uncapped. Used by
	  agnss_client_fetch() when the caller does not override it.

config OSCORE_CLOUD_AGNSS_COMPACT
	bool "Request compact positional-array A-GNSS encoding"
	default y
	help
	  Request the compact response encoding (request field "e":1, agnss-schema.md
	  1.4), which drops per-field CBOR keys (~178 B/SV -> ~78 B/SV). Disable to
	  request the legacy text-key maps.

config OSCORE_CLOUD_AGNSS_GALILEO
	bool "Request and inject Galileo A-GNSS"
	default y if SOC_SERIES_NRF92
	help
	  Ask the server for Galileo I/NAV ephemerides, NeQuick and the
	  GPS-Galileo time offset (request bits 8/9 and NeQuick, agnss-schema.md
	  1.3) and write them to the modem. The NCS Location library only builds
	  GPS/QZSS needs, so the Galileo need is read from
	  nrf_modem_gnss_agnss_expiry_get() at fetch time (see
	  GALILEO-LOCLIB-GAP in agnss_client.c). Needs a Galileo-capable modem
	  (nRF92) and a server with AGNSS_SOURCE=rtcm; other servers ignore the
	  bits.

endif # OSCORE_CLOUD_AGNSS

config OSCORE_CLOUD_PGPS
	bool "OSCORE predicted-GNSS (P-GPS) client"
	help
	  Build the OSCORE predicted-GNSS client that fetches multi-day predicted
	  GPS assistance (POST /p, CBOR over Block2), stores the returned 4 h
	  ephemeris windows, and injects the window covering the current time into
	  the nRF modem GNSS core. With OSCORE_CLOUD_PGPS_STORE the windows go to a
	  flash ring and survive reboots; without it they are RAM-held for the
	  current power cycle only.

if OSCORE_CLOUD_PGPS

config OSCORE_CLOUD_PGPS_WINDOW_COUNT_DEFAULT
	int "Default number of predicted windows to request"
	default 6
	help
	  Number of consecutive 4 h windows (request field "n") pgps_client_fetch()
	  asks for when the caller does not override it. 6 windows = 24 h of
	  predicted assistance. The server clamps to the available horizon.

config OSCORE_CLOUD_PGPS_STORE
	bool "Keep predicted windows in a flash ring"
	depends on FLASH && FLASH_MAP
	default y if $(dt_nodelabel_enabled,pgps_storage)
	help
	  Store downloaded windows in a dedicated flash partition (devicetree
	  nodelabel "pgps_storage") instead of RAM, so a multi-day horizon survives
	  reboots and a device can fix from stored predictions while offline. One
	  4 kB flash sector holds one window; the partition is used as a ring
	  indexed by the window number, so slots expire on their own. Without this,
	  windows live in RAM for the current power cycle only.

	  Defaults on only when the board actually defines a pgps_storage
	  partition, since the store references that nodelabel directly.

config OSCORE_CLOUD_PGPS_STORE_SLOTS
	int "Predicted-window flash ring length"
	depends on OSCORE_CLOUD_PGPS_STORE
	range 6 168
	default 84
	help
	  Number of 4 h window slots in the ring, which is also the horizon it can
	  hold: 84 slots = 14 days = 336 kB of flash (4 kB per slot). The
	  pgps_storage partition must be at least this large.

config OSCORE_CLOUD_PGPS_MAX_WINDOWS
	int "Maximum predicted windows held in RAM"
	depends on !OSCORE_CLOUD_PGPS_STORE
	default 6
	help
	  Sizes the static in-RAM window array used when there is no flash ring.
	  Each slot holds up to a full GPS constellation of compact ephemerides
	  (~2.3 kB), so keep this modest; windows beyond this count in a response
	  are decoded past but not stored. With OSCORE_CLOUD_PGPS_STORE the array
	  is not built at all -- the client keeps only a decode staging buffer and
	  an injection cache, and the horizon is bounded by the ring instead.

config OSCORE_CLOUD_PGPS_FETCH_BATCH
	int "Maximum predicted windows per /p request"
	range 1 12
	default 6
	help
	  Upper bound on how many 4 h windows one POST /p asks for. A long horizon
	  cannot arrive in a single response: 84 windows is ~97 kB, far past the
	  Block2 accumulation buffer and the server's per-device response cache. A
	  fetch for more than this many windows is therefore split into a sequence
	  of requests with an advancing "from", one request per pgps_client_step()
	  call, so the caller's loop keeps servicing other traffic in between.

	  This is only a ceiling. The client lowers it to whatever it expects to
	  fit the accumulation buffer, which depends on how many satellites a
	  window carries: a pruned window holds 12-16, while an unpruned ("all")
	  fetch returns the full constellation and costs about twice as much. If a
	  response overflows the buffer anyway, the batch is halved and retried, so
	  a bad estimate costs a round trip rather than the whole run.

endif # OSCORE_CLOUD_PGPS

config OSCORE_CLOUD_BACKOFF_INITIAL_SECONDS
	int "Default initial reconnection backoff (seconds)"
	default 60
	help
	  Default initial backoff used by oscore_cloud_backoff_seconds() when the
	  application does not override it through struct oscore_cloud_config.

config OSCORE_CLOUD_BACKOFF_MAX_SECONDS
	int "Default maximum reconnection backoff (seconds)"
	default 3600
	help
	  Upper bound for the reconnection backoff computed by
	  oscore_cloud_backoff_seconds().

choice OSCORE_CLOUD_BACKOFF_TYPE
	prompt "Reconnection backoff type"
	default OSCORE_CLOUD_BACKOFF_TYPE_EXPONENTIAL

config OSCORE_CLOUD_BACKOFF_TYPE_EXPONENTIAL
	bool "Exponential backoff"

config OSCORE_CLOUD_BACKOFF_TYPE_LINEAR
	bool "Linear backoff"

config OSCORE_CLOUD_BACKOFF_TYPE_NONE
	bool "Constant (no backoff growth)"

endchoice

config OSCORE_CLOUD_BACKOFF_LINEAR_INCREMENT_SECONDS
	int "Linear backoff increment (seconds)"
	default 60
	help
	  Per-attempt increment for the linear reconnection backoff. Only used
	  when OSCORE_CLOUD_BACKOFF_TYPE_LINEAR is selected, but always defined so
	  the (dead) linear branch in cloud_session.c compiles under the other
	  backoff types too.

# ---------------------------------------------------------------------------
# Device observability (Memfault-style), reported natively over the existing
# OSCORE telemetry uplink. See OBSERVABILITY.md for the wire protocol and the
# backend side.
# ---------------------------------------------------------------------------
menuconfig OSCORE_CLOUD_DIAG
	bool "Device observability (diagnostics)"
	select HWINFO
	select REBOOT
	help
	  Native device observability: reboot-reason tracking, a health-vitals
	  heartbeat, and minimal crash reports. Signals are folded into the
	  ordinary OSCORE telemetry uplink as nested CBOR maps (keys 20/21/22/23)
	  and ingested by the PocketBase server. State persists across a warm reset
	  in a __noinit "retained" RAM region guarded by a magic word and CRC32.

	  With OSCORE_CLOUD_DIAG_AUTO_ATTACH (default y) the session helper folds
	  the signals into every telemetry post automatically; the application only
	  calls oscore_cloud_diag_init() once at boot.

if OSCORE_CLOUD_DIAG

config OSCORE_CLOUD_DIAG_VITALS
	bool "Collect health vitals heartbeat (key 21)"
	default y
	help
	  Sample heap/stack headroom, modem signal quality and battery into a
	  periodic vitals heartbeat folded into telemetry.

config OSCORE_CLOUD_DIAG_CRASH
	bool "Capture minimal crash reports (key 22)"
	default y
	help
	  Install a k_sys_fatal_error_handler that snapshots the fault registers and
	  a slice of the crashing stack into retained RAM, uploaded on the next boot
	  for server-side symbolication.

	  This provides the single definition of k_sys_fatal_error_handler, so the
	  consuming application MUST disable Zephyr's default handler with
	  CONFIG_RESET_ON_FATAL_ERROR=n to avoid a duplicate-symbol link error.

config OSCORE_CLOUD_DIAG_BREADCRUMBS
	bool "Capture log breadcrumbs at crash time"
	default y
	depends on OSCORE_CLOUD_DIAG_CRASH
	depends on LOG
	help
	  Register a lightweight log backend that keeps the most recent log output in
	  a RAM ring. The fatal handler snapshots the ring into retained RAM so the
	  last lines before a crash travel with the crash report (CBOR key 22 "bc")
	  for display next to the symbolicated backtrace.

config OSCORE_CLOUD_DIAG_LOG_RING_SIZE
	int "Live log ring size (bytes)"
	default 8192
	depends on OSCORE_CLOUD_DIAG_BREADCRUMBS
	help
	  Size of the RAM log ring that holds the most recent formatted log lines
	  (timestamp + level + module + message). It lives in ordinary RAM at the
	  well-known symbol `oscore_diag_log_ring`, so a coredump that covers RAM
	  carries it and the server extracts the full log tail leading up to the
	  crash. It is never written to flash on its own (no wear); it reaches
	  flash only inside a coredump.

config OSCORE_CLOUD_DIAG_BREADCRUMB_SIZE
	int "Retained breadcrumb snapshot size (bytes)"
	default 256
	depends on OSCORE_CLOUD_DIAG_BREADCRUMBS
	help
	  Bytes of the log ring's tail copied into retained RAM by the fatal
	  handler. They ride the minimal inline crash report (key 22 "bc"), which
	  must stay small for NTN, so there is no point keeping more than
	  CLOUD_TELEMETRY_MAX_BREADCRUMB here. The full log comes from the
	  coredump.

config OSCORE_CLOUD_DIAG_BUILD_ID
	bool "Embed a GNU build-id and report it as the firmware version"
	default y
	help
	  Reserve a ROM slot for the linker's GNU build-id note (a hash of the
	  binary) via a linker fragment, and expose app_fw_version() /
	  app_build_id_hex(). The auto-generated firmware version is
	  APP_VERSION_STRING + "+" + the first hex digits of the build-id, so every
	  build is distinguishable in the fleet and crash reports carry an exact
	  symbol-ELF selector. Requires an app_version.h (a Zephyr VERSION file in
	  the application).

config OSCORE_CLOUD_DIAG_DEVICE_INFO
	bool "Report static device info once on connect (key 23)"
	default y
	depends on MODEM_INFO
	help
	  Report board name, modem firmware version, IMEI and SIM ICCID one-shot
	  after boot. The server folds these onto the device record.

choice OSCORE_CLOUD_DIAG_COREDUMP_STORAGE
	prompt "Coredump storage backend"
	default OSCORE_CLOUD_DIAG_COREDUMP_BACKEND_NONE
	help
	  Where the fatal handler stores a full Zephyr coredump. NONE leaves the
	  choice to Zephyr's own DEBUG_COREDUMP_BACKEND_* (e.g. in-memory). The
	  NVMC and SPI_NOR backends provide coredump_backend_other, so the
	  application must select CONFIG_DEBUG_COREDUMP_BACKEND_OTHER=y.

config OSCORE_CLOUD_DIAG_COREDUMP_BACKEND_NONE
	bool "Zephyr built-in backend"

config OSCORE_CLOUD_DIAG_COREDUMP_BACKEND_NVMC
	bool "Internal flash (nrfx_nvmc)"
	depends on OSCORE_CLOUD_DIAG_CRASH
	depends on DEBUG_COREDUMP_BACKEND_OTHER
	help
	  Store full coredumps in an internal-flash partition via nrfx_nvmc (safe
	  from the fatal handler on nRF91 non-secure, where the stock flash backend
	  deadlocks). Requires a `coredump_partition` DT nodelabel in internal
	  flash, attributed non-secure. Capacity is limited by internal flash
	  (typically 32 KiB, so only THREADS-scope dumps with short stack tops
	  fit), and the whole partition is erased in the fault handler. Use it
	  only on boards without external flash; prefer SPI_NOR.

config OSCORE_CLOUD_DIAG_COREDUMP_BACKEND_SPI_NOR
	bool "External SPI NOR flash (polled SPIM)"
	depends on OSCORE_CLOUD_DIAG_CRASH
	depends on DEBUG_COREDUMP_BACKEND_OTHER
	depends on SPI_NOR && FLASH_MAP
	depends on SOC_FAMILY_NORDIC_NRF
	select CRC
	help
	  Store full coredumps in a `coredump_partition` on an external
	  jedec,spi-nor device. The fault handler drives the SPIM registers
	  directly (busy-polled, no RTOS primitives) so it is safe with IRQs
	  locked; read-back and erase after the reboot use the normal spi_nor
	  driver. The slot is pre-erased in the background after upload, so a
	  capture is program-only. Running out of space truncates the dump
	  instead of discarding it. The partition must be 64 KiB aligned and a
	  multiple of 64 KiB; 1 MiB holds a full-RAM (LINKER_RAM) dump with room
	  to spare. The SPIM instance, CS GPIO, clock and deep-power-down timing
	  come from the partition's parent node, so any jedec,spi-nor part on an
	  nRF SPIM works (verified: GD25WB256 on the nRF9151 DK, GD25LE255 on the
	  Thingy:91 X).

endchoice

config OSCORE_CLOUD_DIAG_COREDUMP_COMPRESS
	bool "Compress coredumps on upload"
	default y
	depends on OSCORE_CLOUD_DIAG_CRASH && DEBUG_COREDUMP
	help
	  Stream the stored coredump through a byte run-length encoder ("ZRL1")
	  while uploading. RAM dumps are dominated by runs of 0x00 and 0xAA
	  (unused stack fill), so the stream shrinks to between a half and a third
	  (nRF9151 DK: 127 KB -> 42 KB; Thingy:91 X: 178 KB -> 87 KB). Uploads go
	  to the resumable POST /c/o + /c/d routes. A server without them (4.04
	  on /c/o) gets the legacy raw POST /c upload instead.

config OSCORE_CLOUD_DIAG_COREDUMP_KEEP_FIRST
	bool "Keep the first un-uploaded coredump in a crash loop"
	default y
	depends on OSCORE_CLOUD_DIAG_COREDUMP_BACKEND_SPI_NOR
	help
	  When a dump is already pending upload, later crashes do not overwrite
	  it (they are counted as dropped instead). The first crash of a loop is
	  usually the root cause. Disable to always keep the latest crash.

config OSCORE_CLOUD_DIAG_AUTO_ATTACH
	bool "Fold diagnostics into telemetry automatically"
	default y
	depends on OSCORE_CLOUD_SESSION
	help
	  When set, oscore_cloud_send_telemetry() automatically attaches any pending
	  diagnostics to each telemetry post, clears the one-shots on success, and
	  uploads a stored coredump on a terrestrial bearer. Disable to take manual
	  control (e.g. to report observability on a slower cadence): call
	  oscore_cloud_diag_attach()/_attach_clear()/_after_send() yourself.

config OSCORE_CLOUD_DIAG_VITALS_INTERVAL
	int "Telemetry sends between vitals heartbeats"
	default 1
	depends on OSCORE_CLOUD_DIAG_VITALS
	help
	  Attach the vitals heartbeat (key 21) only every Nth call to
	  oscore_cloud_diag_attach(), so fleet-health vitals can ride the telemetry
	  uplink at a lower cadence than the telemetry itself (saving bandwidth on
	  sleepy NTN/NB-IoT links) while still sharing the same packet. 1 = every
	  send. Urgent one-shots (boot report, crash) ignore this and are always
	  attached on the next post.

config OSCORE_CLOUD_DIAG_LIVENESS
	bool "Cloud-contact liveness watchdog (reboot on cloud stall)"
	help
	  Arm a software watchdog that reboots the device if it goes too long
	  without a successful cloud contact. "Contact" is a diag_heartbeat(),
	  which the telemetry path calls after every accepted uplink; each contact
	  reschedules the watchdog, and the timer is armed from boot so a device
	  that never reaches the cloud is recovered too.

	  This catches the "alive but not progressing" failure mode that the
	  per-thread task watchdog cannot see: the threads keep running and feeding
	  their task watchdogs, but the device stops making progress with the cloud
	  (wedged modem link, stuck retry loop, half-open socket, a peripheral that
	  no longer comes up). The reboot is attributed as DIAG_RESET_WATCHDOG.
	  With OSCORE_CLOUD_DIAG_WATCHDOG it raises a fatal error with reason
	  DIAG_FATAL_WATCHDOG_LIVENESS first, so the stall leaves a coredump.

	  Leave disabled on devices that legitimately report less often than the
	  timeout (deep-sleep / NTN duty cycles), or the device will reboot-loop.
	  The timeout MUST be comfortably longer than the worst-case telemetry
	  reporting interval (including retry/backoff).

config OSCORE_CLOUD_DIAG_LIVENESS_TIMEOUT_SECONDS
	int "Cloud-contact liveness timeout (seconds)"
	default 7200
	depends on OSCORE_CLOUD_DIAG_LIVENESS
	help
	  Reboot if no successful cloud contact occurs within this many seconds.
	  Must be well above the telemetry reporting interval so a normally
	  reporting device never trips it. Default is 2 hours.

config OSCORE_CLOUD_DIAG_WATCHDOG
	bool "Watchdogs end in a coredump (task + hardware pre-watchdog)"
	depends on OSCORE_CLOUD_DIAG_CRASH && TASK_WDT && TASK_WDT_HW_FALLBACK
	depends on CPU_CORTEX_M
	select WATCHDOG
	help
	  Make every watchdog expiry go through the fatal/coredump path before
	  the reset, so the dump holds every thread stack and the log ring:

	  - Task level: diag_watchdog_trigger() (call it from a task_wdt
	    callback) records the starved thread in oscore_diag_crash_meta and
	    raises a fatal error with reason DIAG_FATAL_WATCHDOG_TASK. The cloud
	    liveness watchdog uses the same path (DIAG_FATAL_WATCHDOG_LIVENESS).
	  - The library calls task_wdt_init() at boot with the hardware WDT
	    (devicetree alias watchdog0, else wdt0), so the HW fallback is really armed.
	    With OSCORE_CLOUD_DIAG_PRE_WATCHDOG it passes a shim that also
	    re-arms the pre-watchdog on every hardware feed.

if OSCORE_CLOUD_DIAG_WATCHDOG

config OSCORE_CLOUD_DIAG_PRE_WATCHDOG
	bool "Hardware pre-watchdog (zero-latency RTC IRQ ahead of the HW WDT)"
	default y
	depends on SOC_FAMILY_NORDIC_NRF
	depends on ARMV7_M_ARMV8_M_MAINLINE
	select ZERO_LATENCY_IRQS
	help
	  A spare RTC (devicetree chosen "oscore,pre-watchdog-rtc", default
	  rtc0) runs as a zero-latency interrupt, so it preempts irq_lock()
	  sections and every normal ISR. It is re-armed on each hardware WDT
	  feed and fires OSCORE_CLOUD_DIAG_PRE_WATCHDOG_MARGIN_MS before the
	  HW WDT would reset. Its handler takes the interrupted context (the
	  stacked exception frame: stuck PC/LR/xPSR, thread vs ISR from
	  EXC_RETURN) and enters the coredump path with reason
	  DIAG_FATAL_WATCHDOG_HW. The HW WDT stays armed as the final backstop
	  and is fed while the dump is written.

	  The HW WDT period is TASK_WDT_MIN_TIMEOUT + TASK_WDT_HW_FALLBACK_DELAY
	  and task_wdt feeds it at least every TASK_WDT_MIN_TIMEOUT, so
	  TASK_WDT_HW_FALLBACK_DELAY must be larger than the margin (with room
	  for timer jitter), or the pre-watchdog fires in normal operation.

	  The RTC keeps counting while a debugger halts the CPU (the HW WDT
	  pauses), so a long halt trips the pre-watchdog.

config OSCORE_CLOUD_DIAG_PRE_WATCHDOG_MARGIN_MS
	int "Pre-watchdog lead time before the HW WDT reset (ms)"
	default 2000
	range 500 10000
	depends on OSCORE_CLOUD_DIAG_PRE_WATCHDOG
	help
	  How long before the hardware WDT would reset the pre-watchdog fires.
	  Must cover the coredump write (~0.4 s into a pre-erased slot, more if
	  the slot is dirty; the HW WDT is also fed during the write).

endif # OSCORE_CLOUD_DIAG_WATCHDOG

module = OSCORE_CLOUD_DIAG
module-str = OSCORE cloud diagnostics
source "subsys/logging/Kconfig.template.log_config"

endif # OSCORE_CLOUD_DIAG

module = OSCORE_CLOUD
module-str = OSCORE cloud
source "subsys/logging/Kconfig.template.log_config"

endif # OSCORE_CLOUD
```
